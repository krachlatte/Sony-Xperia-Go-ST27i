## arch/arm/mach-ux500/Kconfig
```kconfig
if ARCH_U8500

# Old bootloaders pass the Nomadik machine type, and the MACH_ option named
# after the machine type must be present and selected for machine_is_*() to
# work
config MACH_NOMADIK
	bool

config MACH_HREFV60
	bool
choice
	prompt "Ux500 platform"
	default UX500_SOC_DB8500

config UX500_SOC_DB8500
	select CPU_V7
	select ARM_GIC
	select SMP
	select ARM_ERRATA_753970
	select ARM_ERRATA_754322
	select SYS_SOC
	bool "U8500"

config UX500_SOC_DB5500
	select CPU_V7
	select ARM_GIC
	select SYS_SOC
	bool "U5500"

endchoice

config UX500_SVP
	bool

if UX500_SOC_DB8500

config U8500_SD_MMC_CARD_SUPPORT
	bool

menu "U8500 Machines"

config MACH_U8500
	bool "U8500 MOP500/HREF/custom HW"
	select MACH_NOMADIK
	select MACH_HREFV60
	select U8500_SD_MMC_CARD_SUPPORT
	help
	  Supports the generic U8500 board type used for MOP500/HREF and some
	  custom boards.  Boards using the generic type cannot be built
	  together; select the specific board in the "U8500 HW" option.

config MACH_U8500_PDP
	bool "PDP R1"
	select U8500_SD_MMC_CARD_SUPPORT
	select U8500_SD_MMC_CARD_GPIO_PWR
	help
	  Supports PDP 2.0-2.2++ target board

config MACH_U8500_PDP_R2
	bool "PDP R2"
	select U8500_SD_MMC_CARD_SUPPORT
	help
	  Supports PDP 2.4- target board

config MACH_U8500_KUMQUAT
	bool "Sony Ericsson Kumquat"
	select WLAN_PMUEN_UX500
	select CW1200_USE_GPIO_IRQ
	help
	  Support for the SonyEricsson Kumquat devices.

config MACH_U8500_NYPON
	bool "Sony Ericsson Nypon"
	select WLAN_PMUEN_UX500
	select CW1200_USE_GPIO_IRQ
	help
	  Support for Sony Ericsson Nypon devices.

config MACH_U8500_PEPPER
	bool "Sony Ericsson Pepper"
	select WLAN_PMUEN_UX500
	select CW1200_USE_GPIO_IRQ
	select U8500_SD_MMC_CARD_SUPPORT
	help
	  Support for the SonyEricsson Pepper devices.

config MACH_U8500_LOTUS
	bool "Sony Ericsson Lotus"
	select WLAN_PMUEN_UX500
	select CW1200_USE_GPIO_IRQ
	select U8500_SD_MMC_CARD_SUPPORT
	help
	  Support for the SonyEricsson Lotus devices.


# If you are porting onto a new board, you really should be using a new machine
# type and adding an entry into this list, not the "U8500 HW" list below.

endmenu

if MACH_U8500

choice
	prompt "U8500 HW"
	default MACH_U8500_MOP

config MACH_U8500_MOP
	bool "MOP500/HREF"
	help
	  Supports MOP500/HREF development boards.

endchoice

endif

endif

if UX500_SOC_DB5500

menu "U5500 Machines"

config MACH_SVP5500
	bool "U5500 Simulator (SVP5500)"
	select UX500_SVP
	help
	  Support for the U5500 Simulator

config MACH_B5500
	bool "U5500 Big Board (B5500)"
	help
	  Support for the U5500 Big Board
endmenu

endif

choice
	prompt "Ux500 UIB Keylayout"
	default KEYLAYOUT_LAYOUT1

config KEYLAYOUT_LAYOUT1
	bool "UIB Keylayout 1; for generic users"
	help
	  Supported keylayout for some numerics, power/call buttons,
	  volume control etc

config KEYLAYOUT_LAYOUT2
	bool "UIB Keylayout 2; for connectivity users"
	help
	  Supports keylayout numerics 0-9, left/right/up/down/back/
	  enter keys and special character "."(dot)

endchoice

choice
	prompt "Ux500 sched_clock timer"
	default UX500_MTU_TIMER

config U8500_PRCMU_TIMER
	bool "PRCMU Timer sched_clock"
	depends on !HAS_MTU
	help
	  Add support for an always on sched_clock, required for
	  proper cpuidle and suspend.

config UX500_MTU_TIMER
	bool "Multi Timer Unit sched_clock"
	help
	  Add sched_clock support for the Multi Timer Unit.
	  Since mtu isn't always on cpuidle will not
	  work with this clock.

endchoice

config U8500_PRCMU
	bool "U8500 PRCMU support"
	depends on UX500_SOC_DB8500
	default n
	help
	  Add support for PRCMU for U8500

config U5500_PRCMU
	bool "U5500 PRCMU support"
	depends on UX500_SOC_DB5500
	default y
	help
	  Add support for PRCMU for U5500

config UX500_PRCMU_QOS_POWER
	bool "UX500 PRCMU power QoS support"
	depends on (U5500_PRCMU || U8500_PRCMU)
	default y
	help
	  Add support for PRCMU power Quality of Service

config UX500_PRCMU_DEBUG
	bool "PRCMU debug"
	depends on ((U5500_PRCMU || U8500_PRCMU) && DEBUG_FS)
	default n
	help
	  Add support for PRCMU debug

config U8500_SAVE_RESET_REASON
	bool "Save reset reason before restart"
	depends on U8500_PRCMU
	default n
	help
	  By enable this will save reset reason onto prcmu regs
	  before a system reset.

config STE_PREFIX_RSTREASN
	bool "ST-E prefix for reset reason"
	depends on (U8500_PRCMU || U5500_PRCMU)
	default n
	help
	  Support for reset reason parameter in function arch_reset()

config U8500_REGULATOR_DEBUG
	bool "Regulator debug support"
	depends on REGULATOR_VIRTUAL_CONSUMER

config U5500_PWM
	bool "PWM support"
	default y
	depends on UX500_SOC_DB5500
	help
	  Add support for PWM for U5500

config MOP500_SDI
	bool
	default y
	depends on ((MACH_U8500_MOP || MACH_U8500_PDP) && MMC_ARMMMCI)

config ARCH_HAS_CPU_IDLE_WAIT
	def_bool y

config UX500_DEBUG_UART
	int "Ux500 UART to use for low-level debug"
	default 2 if UX500_SOC_DB8500
	default 0 if UX500_SOC_DB5500
	help
	  Choose the UART on which kernel low-level debug messages should be
	  output.


config SENSORS1P_MOP
	tristate "HAL and Proximity sensors support"
	depends on REGULATOR && (GPIO_STMPE2401 || GPIO_TC35892)
	default y
	help
	  Add support for Osram's SFH7741 Proximity Sensor and Samsumg
	  HED54XXU11 HAL Switch

config U5500_MODEM_IRQ
	bool "Modem IRQ support"
	depends on UX500_SOC_DB5500
	default y
	help
	  Add support for handling IRQ:s from modem side

config MOP500_NUIB
	bool "MOP500 NUIB"
	depends on MACH_U8500_MOP
	default y
	help
	  Add support for the platform data of synaptics rmi4 driver

config TEE_UX500
	bool "Trusted Execution Environment (TEE) ux500 hardware support"
	depends on TEE_SUPPORT
	default y
	help
	  Adds TEE hardware support for ux500 platforms.

config TEE_SVP
	bool "Trusted Execution Environment (TEE) ux500 SVP support"
	depends on TEE_SUPPORT && UX500_SVP
	default y
	help
	  Adds TEE support for SVP in ux500 platforms.

config DB8500_MLOADER
	bool "Modem firmware upload/download support"
	depends on UX500_SOC_DB8500
	select DBX500_MLOADER
	default n
	help
	  Adds Modem firmware upload/download support to DB8500.

config U5500_MLOADER
	bool "mLoader, mem config from kernel boot args exported to sysfs"
	depends on UX500_SOC_DB5500
	help
	  Link between boot args and user space program that loads the modem ELF.
	  This is used to expose the modem parameters using sysfs interface.

config UX500_DEBUG_HWREG
	bool "Debug hardware registers from userspace"
	depends on (DEBUG_FS && UX500_SOC_DB8500)
	help
	  Adds various debug files to access registers.
	  This should never ever be used for anything else than debugging.

config UX500_DEBUG_NO_LAUTERBACH
       bool "Disable clocks needed for Lauterbach debugging"
       help
	  Disable clocks needed for Lauterbach debugging at boot.
	  If yes, you will reduce the power consumption.

config UX500_L2X0_PREFETCH_CTRL
	bool "PL310 prefetch control"
	depends on (UX500_SOC_DB8500 || UX500_SOC_DB5500) && \
			(TEE_UX500 && CACHE_L2X0)
	default y
	help
	  Adds interface to control instruction and data prefetch.
	  Communication with Trustzone is done through TEE driver.

source "arch/arm/mach-ux500/Kconfig-arch"
source "arch/arm/mach-ux500/pm/Kconfig"

config SIMPLE_REMOTE_PLATFORM
	bool "Simple Remote platform specific driver"
	default n
	help
	  Provides support for detecting 3.5mm audio jack, such as wired
	  headset. This is the platform specific layer.

config SIMPLE_REMOTE_INVERT_PLUG_DETECTION_STATE
	bool "Invert state of plug detection"
	depends on SIMPLE_REMOTE_PLATFORM
	help
	  This option enables to invert headphone plug detection state,
	  currently the plug detection state was low state when headphone
	  was inserted, but it is high state on some products, so that
	  we need invert this state on these products.

config USB_PRODUCT_SUFFIX
	hex "Suffix of USB product id"
	default 0

config WLAN_PMUEN_UX500
	bool "Wlan PMU Enable is controlled separately from GBF_RST"
	default n
	help
	  CW1200-PMU_en will be enabled 300 usecs before CG2900-PDB_en.

	  This is required on some boards for Bluetooth to start.

config U8500_SD_MMC_CARD_GPIO_PWR
	bool "Configure SD/MMC Card power enable to be controlled via GPIO pin."
	depends on U8500_SD_MMC_CARD_SUPPORT
	default n
	help
	  This option enables the use of a GPIO pin to power the SD/MMC Card.

endif
```

## drivers/input/rmi4/Kconfig
```kconfig
#
# RMI4 configuration
#
config RMI4_BUS
	tristate "Synaptics RMI4 bus support"
	help
	  Say Y here if you want to support the Synaptics RMI4 bus.

	  If unsure, say Y.

	  To compile this driver as a module, choose M here: the
	  module will be called rmi-bus.

config RMI4_I2C
	tristate "RMI4 I2C Support"
	depends on RMI4_BUS && I2C
	help
	  Say Y here if you want to support RMI4 devices connected to an I2C
	  bus.

	  If unsure, say Y.

	  To compile this driver as a module, choose M here: the
	  module will be called rmi-i2c.

config RMI4_SPI
	tristate "RMI4 SPI Support"
	depends on RMI4_BUS && SPI
	help
	  Say Y here if you want to support RMI4 devices connected to an SPI
	  bus.

	  If unsure, say Y.

	  To compile this driver as a module, choose M here: the
	  module will be called rmi-spi.

config RMI4_GENERIC
	tristate "RMI4 Generic driver"
	depends on RMI4_BUS
	help
	  Say Y here if you want to support generic RMI4 devices.

	  This is pretty much required if you want to do anything useful with
	  your RMI device.

	  To compile this driver as a module, choose M here: the
	  module will be called rmi-generic.

config RMI4_F11
	tristate "RMI4 Function 11 (2D pointing)"
	depends on RMI4_BUS && RMI4_GENERIC
	help
	  Say Y here if you want to add support for RMI4 function 11.

	  Function 11 provides 2D multifinger pointing for touchscreens and
	  touchpads.  For sensors that support relative pointing, F11 also
	  provides mouse input.

	  To compile this driver as a module, choose M here: the
	  module will be called rmi-f11.

config RMI4_F19
	tristate "RMI4 Function 19 (0D pointing)"
	depends on RMI4_BUS && RMI4_GENERIC
	help
	  Say Y here if you want to add support for RMI4 function 19.

	  Function 19 provides support for capacitive buttons for sensors
	  that implement capacitive buttons.

	  To compile this driver as a module, choose M here: the
	  module will be called rmi-f19.

config RMI4_F34
	tristate "RMI4 Function 34 (device reflash)"
	depends on RMI4_BUS && RMI4_GENERIC
	help
	  Say Y here if you want to add support for RMI4 function 34.

	  Function 34 provides firmware upgrade capability for your sensor.

	  To compile this driver as a module, choose M here: the
	  module will be called rmi-f34.

config RMI4_F54
	tristate "RMI4 Function 54 (analog diagnostics)"
	depends on RMI4_BUS && RMI4_GENERIC
	help
	  Say Y here if you want to add support for RMI4 function 54.

	  Function 54 provides access to various diagnostic features in
	  certain RMI4 touch sensors.

	  To compile this driver as a module, choose M here: the
	  module will be called rmi-f54.

config RMI4_DEV
	bool "Synaptics direct RMI device support (rmidev)"
	depends on GPIO_SYSFS && (RMI4_I2C || RMI4_SPI)
	help
	  Say Y here to add support for rmidev.

	  The rmidev feature implements a character device providing access
	  to RMI4 sensor register maps.

	  This is not currently available as a loadable module.
```

## drivers/mmc/core/Kconfig
```kconfig
#
# MMC core configuration
#

config MMC_UNSAFE_RESUME
	bool "Assume MMC/SD cards are non-removable (DANGEROUS)"
	help
	  If you say Y here, the MMC layer will assume that all cards
	  stayed in their respective slots during the suspend. The
	  normal behaviour is to remove them at suspend and
	  redetecting them at resume. Breaking this assumption will
	  in most cases result in data corruption.

	  This option is usually just for embedded systems which use
	  a MMC/SD card for rootfs. Most people should say N here.

	  This option sets a default which can be overridden by the
	  module parameter "removable=0" or "removable=1".

config MMC_EMBEDDED_SDIO
	boolean "MMC embedded SDIO device support (EXPERIMENTAL)"
	depends on EXPERIMENTAL
	help
	  If you say Y here, support will be added for embedded SDIO
	  devices which do not contain the necessary enumeration
	  support in hardware to be properly detected.

config MMC_PARANOID_SD_INIT
	bool "Enable paranoid SD card initialization (EXPERIMENTAL)"
	depends on EXPERIMENTAL
	help
	  If you say Y here, the MMC layer will be extra paranoid
	  about re-trying SD init requests. This can be a useful
	  work-around for buggy controllers and hardware. Enable
	  if you are experiencing issues with SD detection.

config MMC_SD_CHECK_BOOT_SIGNATURE
	bool "Safety for uSD card short circuit"
	default n
	help
	  If you say Y here, uSD driver checks boot signature
	  in MBR when detecting uSD card.If boot signature(0xAA55)
	  is invalid, uSD driver considers it as broken or
	  unformatted card and turns SD_VDD off.This avoids
	  abnormal behavior(e.g over current by short mode) with
	  cracked uSD.

config MMC_ENABLE_BKOPS
	bool "Enable background operations"
	default n
	help
	  If you say Y here, use of the background operations option
	  will be enabled, if supported. This sets the BKOPS_EN flag in
	  the eMMC which is "one time programmable" i.e. once set it cannot
	  be unset.
```
